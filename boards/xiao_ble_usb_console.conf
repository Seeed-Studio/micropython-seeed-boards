## boards/xiao_stm32c5.conf
```kconfig
# XIAO STM32C5 MicroPython configuration
CONFIG_BUILD_OUTPUT_BIN=y
CONFIG_BUILD_OUTPUT_HEX=y
CONFIG_REBOOT=y

CONFIG_STDOUT_CONSOLE=y
CONFIG_CONSOLE=y
CONFIG_CONSOLE_HANDLER=y
CONFIG_UART_CONSOLE=y
CONFIG_UART_CONSOLE_DEBUG_SERVER_HOOKS=y

CONFIG_NEWLIB_LIBC=y
# The system arm-none-eabi newlib headers leave this toolchain feature
# disabled by default, while Zephyr's newlib hooks require it when
# CONFIG_MULTITHREADING is enabled.
CONFIG_COMPILER_OPT="-D_RETARGETABLE_LOCKING=1"
CONFIG_FPU=y
CONFIG_MAIN_STACK_SIZE=8192
CONFIG_MICROPY_HEAP_SIZE=65536
CONFIG_POLL=y
CONFIG_DEVICE_DT_METADATA=y

CONFIG_MICROPY_CONFIGFILE="mpconfigport.h"
CONFIG_MICROPY_VFS_LFS2=y
CONFIG_MICROPY_FROZEN_MODULES=y
CONFIG_MICROPY_FROZEN_MANIFEST="../../../../boards/xiao_stm32c5_manifest.py"

CONFIG_SERIAL=y
CONFIG_UART_INTERRUPT_DRIVEN=y
CONFIG_UART_LINE_CTRL=y
CONFIG_UART_USE_RUNTIME_CONFIGURE=y

CONFIG_GPIO=y
CONFIG_ADC=y
CONFIG_I2C=y
CONFIG_PWM=y
CONFIG_CAN=y
CONFIG_CAN_FD_MODE=y
CONFIG_RTC=y

CONFIG_FLASH=y
CONFIG_FLASH_MAP=y
CONFIG_FLASH_PAGE_LAYOUT=y
CONFIG_FILE_SYSTEM=y
CONFIG_FILE_SYSTEM_LITTLEFS=y

CONFIG_SENSOR=y
CONFIG_LSM6DSL=y
CONFIG_LSM6DSL_ENABLE_TEMP=y

CONFIG_LEGACY_GENERATED_INCLUDE_PATH=n
```
